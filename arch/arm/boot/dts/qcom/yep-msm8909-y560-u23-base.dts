/* Copyright (c) 2014, The Linux Foundation. All rights reserved.
 *
 * This program is free software; you can redistribute it and/or modify
 * it under the terms of the GNU General Public License version 2 and
 * only version 2 as published by the Free Software Foundation.
 *
 * This program is distributed in the hope that it will be useful,
 * but WITHOUT ANY WARRANTY; without even the implied warranty of
 * MERCHANTABILITY or FITNESS FOR A PARTICULAR PURPOSE.  See the
 * GNU General Public License for more details.
 */

/*  Date            Author          Why
    2014-01-12      litao2          creat
*/  
 
/dts-v1/;

#include "yep-msm8909-y560-u23-base.dtsi"

/ {
	qcom,board-id=<0x1000b 0x1008>, <0x11000b 0x1008>, <0x21000b 0x1008>, <0x1000b 0x8>, <0x11000b 0x8>, <0x21000b 0x8>;
};

