/* Copyright (c) 2013, The Linux Foundation. All rights reserved.
 *
 * This program is free software; you can redistribute it and/or modify
 * it under the terms of the GNU General Public License version 2 and
 * only version 2 as published by the Free Software Foundation.
 *
 * This program is distributed in the hope that it will be useful,
 * but WITHOUT ANY WARRANTY; without even the implied warranty of
 * MERCHANTABILITY or FITNESS FOR A PARTICULAR PURPOSE.  See the
 * GNU General Public License for more details.
 */

/*---------------------------------------------------------------------------
 * This file is autogenerated file using gcdb parser. Please do not edit it.
 * Update input XML file to add a new entry or update variable in this file
 * VERSION = "1.0"
 *---------------------------------------------------------------------------*/
 /* Date            Author       IC              Module        	Why
   2015-02-14      zhouwentao   ili9806e        90245254976a   update gama para and add code version 
	2015-03-06		zhouwentao   ili9806e		90245254976a	update timing
 	2015-03-18		guohongtao   ili9806e		90245254976a	add ulps mode
	2015-04-01		lihuiqin      ili9806e		90245254976a	modify parameter for gamma
        2015-03-27     lihuiqin    ili9806e       90245254976a  modify parameter for  gamma
	2015-03-30     lihuiqin    ili9806e       90245254976a  modify parameter for  flicker 
        2015-04-09     xingbin    ili9806e       90245254976a    open CE 
        2015-04-16     xingbin    ili9806e       90245254976a    add lcd physical size
        2015-04-23     xingbin    HX8379C       90245254976a    modify sleep in cmd to hs for display flicker when charging at pawer off
      	2015-04-23     xingbin    HX8379C       90245254976a    add 4fps delay for display flicker at resume
      	2015-05-07     xingbin    ili9806e       90245254976a    move lcd reset to MIPI LP11
*/
&mdss_mdp {
	dsi_ili9806e_dijing_hsd4p5inch_fwvga_vid: qcom,ili9806e_dijing_hsd4p5inch {
		qcom,mdss-dsi-panel-name = "ili9806e dijing hsd4p5 fwvga";
		qcom,mdss-dsi-panel-code-version="@20150423"; 
		qcom,mdss-dsi-panel-controller = <&mdss_dsi0>;
		qcom,mdss-dsi-panel-type = "dsi_video_mode";
		qcom,mdss-dsi-panel-destination = "display_1";
		qcom,mdss-dsi-panel-framerate = <60>;
		qcom,mdss-dsi-virtual-channel-id = <0>;
		qcom,mdss-dsi-stream = <0>;
		qcom,mdss-dsi-panel-width = <480>;
		qcom,mdss-dsi-panel-height = <854>;
		qcom,mdss-dsi-h-front-porch = <60>;
		qcom,mdss-dsi-h-back-porch = <60>;
		qcom,mdss-dsi-h-pulse-width = <10>;
		qcom,mdss-dsi-h-sync-skew = <0>;
		qcom,mdss-dsi-v-back-porch = <20>;
		qcom,mdss-dsi-v-front-porch = <12>;
		qcom,mdss-dsi-v-pulse-width = <4>;
		qcom,mdss-dsi-h-left-border = <0>;
		qcom,mdss-dsi-h-right-border = <0>;
		qcom,mdss-dsi-v-top-border = <0>;
		qcom,mdss-dsi-v-bottom-border = <0>;
		qcom,mdss-dsi-bpp = <24>;
		qcom,mdss-dsi-color-order = <0>;
		qcom,mdss-dsi-underflow-color = <0xff>;
		qcom,mdss-dsi-border-color = <0>;
		qcom,mdss-dsi-pixel-packing = <0>;
		qcom,mdss-dsi-on-command = [
		29 01 00 00 00 00 06 FF FF 98 06 04 01
		29 01 00 00 00 00 02 08 10
		29 01 00 00 00 00 02 21 01
		29 01 00 00 00 00 02 30 01
		29 01 00 00 00 00 02 31 02
		29 01 00 00 00 00 02 40 18
		29 01 00 00 00 00 02 41 33
		29 01 00 00 00 00 02 42 02
		29 01 00 00 00 00 02 43 09
		29 01 00 00 00 00 02 44 09
		29 01 00 00 00 00 02 50 80
		29 01 00 00 00 00 02 51 80
		29 01 00 00 00 00 02 52 00
		29 01 00 00 00 00 02 53 45
		//29 01 00 00 00 00 02 56 01
		29 01 00 00 00 00 02 57 50
		29 01 00 00 00 00 02 60 0A
		29 01 00 00 00 00 02 61 00
		29 01 00 00 00 00 02 62 08
		29 01 00 00 00 00 02 63 00
		29 01 00 00 00 00 02 A0 00
		29 01 00 00 00 00 02 A1 06
		29 01 00 00 00 00 02 A2 10
		29 01 00 00 00 00 02 A3 11
		29 01 00 00 00 00 02 A4 0A
		29 01 00 00 00 00 02 A5 19
		29 01 00 00 00 00 02 A6 09
		29 01 00 00 00 00 02 A7 08
		29 01 00 00 00 00 02 A8 04
		29 01 00 00 00 00 02 A9 0A
		29 01 00 00 00 00 02 AA 03
		29 01 00 00 00 00 02 AB 06
		29 01 00 00 00 00 02 AC 0B
		29 01 00 00 00 00 02 AD 34
		29 01 00 00 00 00 02 AE 32
		29 01 00 00 00 00 02 AF 1F
		29 01 00 00 00 00 02 C0 00
		29 01 00 00 00 00 02 C1 05
		29 01 00 00 00 00 02 C2 10
		29 01 00 00 00 00 02 C3 10
		29 01 00 00 00 00 02 C4 08
		29 01 00 00 00 00 02 C5 15
		29 01 00 00 00 00 02 C6 0B
		29 01 00 00 00 00 02 C7 08
		29 01 00 00 00 00 02 C8 04
		29 01 00 00 00 00 02 C9 07
		29 01 00 00 00 00 02 CA 07
		29 01 00 00 00 00 02 CB 03
		29 01 00 00 00 00 02 CC 0A
		29 01 00 00 00 00 02 CD 27
		29 01 00 00 00 00 02 CE 24
		29 01 00 00 00 00 02 CF 1F
		29 01 00 00 00 00 06 FF FF 98 06 04 06
		29 01 00 00 00 00 02 00 21
		29 01 00 00 00 00 02 01 0A
		29 01 00 00 00 00 02 02 00
		29 01 00 00 00 00 02 03 00
		29 01 00 00 00 00 02 04 01
		29 01 00 00 00 00 02 05 01
		29 01 00 00 00 00 02 06 80
		29 01 00 00 00 00 02 07 06
		29 01 00 00 00 00 02 08 01
		29 01 00 00 00 00 02 09 80
		29 01 00 00 00 00 02 0A 00
		29 01 00 00 00 00 02 0B 00
		29 01 00 00 00 00 02 0C 0a
		29 01 00 00 00 00 02 0D 0a
		29 01 00 00 00 00 02 0E 00
		29 01 00 00 00 00 02 0F 00
		29 01 00 00 00 00 02 10 F0
		29 01 00 00 00 00 02 11 F4
		29 01 00 00 00 00 02 12 04
		29 01 00 00 00 00 02 13 00
		29 01 00 00 00 00 02 14 00
		29 01 00 00 00 00 02 15 C0
		29 01 00 00 00 00 02 16 08
		29 01 00 00 00 00 02 17 00
		29 01 00 00 00 00 02 18 00
		29 01 00 00 00 00 02 19 00
		29 01 00 00 00 00 02 1A 00
		29 01 00 00 00 00 02 1B 00
		29 01 00 00 00 00 02 1C 00
		29 01 00 00 00 00 02 1D 00
		29 01 00 00 00 00 02 20 01
		29 01 00 00 00 00 02 21 23
		29 01 00 00 00 00 02 22 45
		29 01 00 00 00 00 02 23 67
		29 01 00 00 00 00 02 24 01
		29 01 00 00 00 00 02 25 23
		29 01 00 00 00 00 02 26 45
		29 01 00 00 00 00 02 27 67
		29 01 00 00 00 00 02 30 01
		29 01 00 00 00 00 02 31 11
		29 01 00 00 00 00 02 32 00
		29 01 00 00 00 00 02 33 EE
		29 01 00 00 00 00 02 34 FF
		29 01 00 00 00 00 02 35 BB
		29 01 00 00 00 00 02 36 CA
		29 01 00 00 00 00 02 37 DD
		29 01 00 00 00 00 02 38 AC
		29 01 00 00 00 00 02 39 76
		29 01 00 00 00 00 02 3A 67
		29 01 00 00 00 00 02 3B 22
		29 01 00 00 00 00 02 3C 22
		29 01 00 00 00 00 02 3D 22
		29 01 00 00 00 00 02 3E 22
		29 01 00 00 00 00 02 3F 22
		29 01 00 00 00 00 02 40 22
		29 01 00 00 00 00 02 52 10
		29 01 00 00 00 00 02 53 10
		29 01 00 00 00 00 06 FF FF 98 06 04 07
		29 01 00 00 00 00 02 17 22
		29 01 00 00 00 00 02 02 77
		29 01 00 00 00 00 02 E1 79
		29 01 00 00 00 00 02 06 12
		29 01 00 00 00 00 06 FF FF 98 06 04 05
		29 01 00 00 00 00 02 00 06
		29 01 00 00 00 00 02 04 00
		29 01 00 00 00 00 06 FF FF 98 06 04 00
		29 01 00 00 00 00 02 35 00
		
		39 01 00 00 05 00 02 55 90
		39 01 00 00 78 00 02 11 00
		39 01 00 00 14 00 02 29 00
		];
		qcom,mdss-dsi-off-command = [05 01 00 00 32 00 02 28 00
					05 01 00 00 78 00 02 10 00];
		qcom,mdss-dsi-on-command-state = "dsi_lp_mode";
		qcom,mdss-dsi-off-command-state = "dsi_hs_mode";
		qcom,mdss-pan-physical-width-dimension = <55>;
		qcom,mdss-pan-physical-height-dimension = <98>;
		qcom,mdss-dsi-h-sync-pulse = <1>;
		qcom,mdss-dsi-traffic-mode = <2>;
		qcom,mdss-dsi-lane-map = <0>;
		qcom,suspend-ulps-enabled;
		qcom,mdss-dsi-lp11-init;
		qcom,mdss-dsi-bllp-eof-power-mode;
		qcom,mdss-dsi-bllp-power-mode;
		qcom,mdss-dsi-lane-0-state;
		qcom,mdss-dsi-lane-1-state;
		/*qcom,mdss-dsi-lane-2-state;
		qcom,mdss-dsi-lane-3-state;*/
		qcom,mdss-dsi-panel-timings = [76 18 10 00 3a 3e 14 1c 12 03 04 00];
		qcom,mdss-dsi-t-clk-post = <0x20>;
		qcom,mdss-dsi-t-clk-pre = <0x2D>;
		qcom,mdss-dsi-bl-min-level = <0>;
		qcom,mdss-dsi-bl-max-level = <255>;
		qcom,mdss-dsi-dma-trigger = <4>;
		qcom,mdss-dsi-mdp-trigger = <0>;
		qcom,mdss-pan-bl-levels = <1 255>;
		qcom,mdss-dsi-bl-pmic-control-type = "bl_ctrl_dcs";
		qcom,mdss-dsi-bl-pmic-pwm-frequency = <100>;
		qcom,mdss-dsi-bl-pmic-bank-select = <0>;
		qcom,mdss-dsi-pwm-gpio = <&pm8909_mpps 2 0>;
		qcom,mdss-dsi-reset-sequence = <1 10>, <0 10>, <1 120>;
		qcom,mdss-dsi-post-init-delay = <4>;
	};
};
