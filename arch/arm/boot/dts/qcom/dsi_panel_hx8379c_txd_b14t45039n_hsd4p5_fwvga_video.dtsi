/* Copyright (c) 2013, The Linux Foundation. All rights reserved.
 *
 * This program is free software; you can redistribute it and/or modify
 * it under the terms of the GNU General Public License version 2 and
 * only version 2 as published by the Free Software Foundation.
 *
 * This program is distributed in the hope that it will be useful,
 * but WITHOUT ANY WARRANTY; without even the implied warranty of
 * MERCHANTABILITY or FITNESS FOR A PARTICULAR PURPOSE.  See the
 * GNU General Public License for more details.
 */
/*modify by zhouwentao for cayou huatai LCD display effect 2014.7.11*/
/*---------------------------------------------------------------------------
 * This file is autogenerated file using gcdb parser. Please do not edit it.
 * Update input XML file to add a new entry or update variable in this file
 * VERSION = "1.0"
 *---------------------------------------------------------------------------*/
/*
	Date            Author          IC                Module        Why
	2014-12-10      xingbin      HX8379C              tongxingda    add tongxingda lcd drivers for 701  
	2015-01-07      xingbin      HX8379C              tongxingda    modify lcd proch and set reset to LP11      
	2015-01-15      xingbin      HX8379C              tongxingda    modify lcd panel info 
	2015-01-19     xingbin       HX8379C              tongxingda    update lcd panel parameters  	
	2015-01-24     xingbin       HX8379C              tongxingda    update lcd panel parameters  	
	2015-01-24     xingbin       HX8379C              tongxingda    modify lcd panel timming and proch 	
	2015-01-26     xingbin       HX8379C              tongxingda    modify lcd porch
	2015-02-14		zhouwentao   HX8379C           		add code version 
	2015-04-01		lihuiqin   HX8379C           		modify parameter for gamma 
	2015-04-07		xingbin      HX8379C           		modify lcd proch for THS_TRAIL
	2015-04-08		xingbin      HX8379C           		modify reset  sequence to optimize resume time
	2015-04-09     xingbin       HX8379C              tongxingda    disable  CE 
	2015-04-15     xingbin       HX8379C              tongxingda    modify for  bright line
	2015-04-16     xingbin    HX8379C       tongxingda    add lcd physical size
	2015-04-23     xingbin    HX8379C       tongxingda    modify sleep in cmd to hs for display flicker when charging at pawer off
	2015-04-23     xingbin    HX8379C       tongxingda    add 4fps delay for display flicker at resume
	2015-05-07     xingbin    HX8379C       tongxingda    move lcd reset to MIPI LP11
  */
&mdss_mdp {
	dsi_hx8379c_txd_hsd_4p5_fwvga_vid: qcom,dsi_panel_hx8379c_txd_hsd4p5_fwvga_video {
		qcom,mdss-dsi-panel-name = "hx8379c txd hsd4p5 fwvga";
		qcom,mdss-dsi-panel-code-version="@20150423"; 
		qcom,mdss-dsi-panel-controller = <&mdss_dsi0>;
		qcom,mdss-dsi-panel-type = "dsi_video_mode";
		qcom,mdss-dsi-panel-destination = "display_1";
		qcom,mdss-dsi-panel-framerate = <60>;
		qcom,mdss-dsi-virtual-channel-id = <0>;
		qcom,mdss-dsi-stream = <0>;
		qcom,mdss-dsi-panel-width = <480>;
		qcom,mdss-dsi-panel-height = <854>;
		qcom,mdss-dsi-h-front-porch = <60>;
		qcom,mdss-dsi-h-back-porch = <60>;
		qcom,mdss-dsi-h-pulse-width = <12>;
		qcom,mdss-dsi-h-sync-skew = <0>;
		qcom,mdss-dsi-v-back-porch = <8>;
		qcom,mdss-dsi-v-front-porch = <12>;
		qcom,mdss-dsi-v-pulse-width = <5>;
		qcom,mdss-dsi-h-left-border = <0>;
		qcom,mdss-dsi-h-right-border = <0>;
		qcom,mdss-dsi-v-top-border = <0>;
		qcom,mdss-dsi-v-bottom-border = <0>;
		qcom,mdss-dsi-bpp = <24>;
		qcom,mdss-dsi-color-order = <0>;
		qcom,mdss-dsi-underflow-color = <0xff>;
		qcom,mdss-dsi-border-color = <0>;
		qcom,mdss-dsi-pixel-packing = <0>;
		qcom,mdss-dsi-on-command = [
		39 01 00 00 00 00 04 B9 FF 83 79
		39 01 00 00 00 00 11 B1 44 16 16 31 31 50 D0 EE 54 80 38 38 F8 22 22 22 
		39 01 00 00 00 00 0a B2 82 FE 0d 0a 00 50 11 42 1D
		39 01 00 00 00 00 0b B4 02 7C 02 7C 02 7C 22 86 23 86
		39 01 00 00 00 00 02 CC 02
		39 01 00 00 00 00 02 D2 11
		39 01 00 00 00 00 1E D3 00 07 00 3c 1F 08 08 32 10 04 00 04 03 70 03 70 00 08 00 08 37 33 06 06 37 06 06 37 0b 
		39 01 00 00 00 00 23 D5 19 19 18 18 1a 1a 1b 1b 02 03 00 01 06 07 04 05 20 21 22 23 18 18 18 18 18 18 18 18 18 18 18 18 00 00
		39 01 00 00 00 00 21 D6 18 18 19 19 1A 1A 1B 1B 03 02 05 04 07 06 01 00 23 22 21 20 18 18 18 18 18 18 18 18 18 18 18 18
		39 01 00 00 00 00 2b E0 00 04 07 09 0b 20 18 2c 08 0b 0c 17 10 15 17 15 15 07 11 13 16 00 04 07 09 0b 20 18 2c 08 0b 0c 17 10 15 17 15 15 07 11 13 16
		39 01 00 00 00 00 03 B6 56 56
		39 01 00 00 00 00 06 C9 1F 00 1E 1E 81
		39 01 00 00 00 00 05 C7 00 00 00 C0
		39 01 00 00 02 00 02 55 00
		39 01 00 00 00 00 02 E4 C0		
		05 01 00 00 78 00 02 11 00
		05 01 00 00 14 00 02 29 00 
			];
		qcom,mdss-dsi-off-command = [05 01 00 00 32 00 02 28 00
					05 01 00 00 78 00 02 10 00];
		qcom,mdss-dsi-on-command-state = "dsi_lp_mode";
		qcom,mdss-dsi-off-command-state = "dsi_hs_mode";
		qcom,suspend-ulps-enabled;
		qcom,mdss-pan-physical-width-dimension = <55>;
		qcom,mdss-pan-physical-height-dimension = <98>;
		qcom,mdss-dsi-lp11-init;
		qcom,mdss-dsi-h-sync-pulse = <1>;
		qcom,mdss-dsi-traffic-mode = <2>;
		qcom,mdss-dsi-lane-map = <0>;
		qcom,mdss-dsi-bllp-eof-power-mode;
		qcom,mdss-dsi-bllp-power-mode;
	//qcom,mdss-dsi-dma-trigger = <4>;
	//qcom,mdss-dsi-mdp-trigger = <0>;
		qcom,mdss-dsi-lane-0-state;
		qcom,mdss-dsi-lane-1-state;
		qcom,mdss-dsi-panel-timings = [8E 18 10 00 3A 3E 14 1C 12 03 04 00];
		qcom,mdss-dsi-t-clk-post = <0x04>;
		qcom,mdss-dsi-t-clk-pre = <0x1B>;
		qcom,mdss-dsi-bl-min-level = <0>;
		qcom,mdss-dsi-bl-max-level = <255>;
		qcom,mdss-dsi-dma-trigger = <4>;
		qcom,mdss-dsi-mdp-trigger = <0>;
		qcom,mdss-pan-bl-levels = <1 255>;
		qcom,mdss-dsi-bl-pmic-control-type = "bl_ctrl_dcs";
		qcom,mdss-dsi-bl-pmic-pwm-frequency = <100>;
		qcom,mdss-dsi-bl-pmic-bank-select = <0>;
		qcom,mdss-dsi-pwm-gpio = <&pm8909_mpps 2 0>;
		qcom,mdss-dsi-reset-sequence = <1 10>, <0 10>, <1 50>;
		qcom,mdss-dsi-post-init-delay = <4>;

	};
};
