## arch/arm/mach-msm/product_list/Kconfig
```kconfig
#
#     date      	author      	why
#  2015.01.10     litao2		add y560 product
#

#
# YEP_product_list
#  
#========================================================
#==========y560 CONFIG BEGIN===========================
config Y560_U23_BASE
	depends on ARCH_MSM8909
	bool "Y560_U23_BASE version"
	help
	  Fix version type as Y560_U23_BASE.
	  
config Y560_L01_BASE
	depends on ARCH_MSM8909
	bool "Y560_L01_BASE version"
	help
	  Fix version type as Y560_L01_BASE.
	  
config Y560_L02_BASE
	depends on ARCH_MSM8909
	bool "Y560_L02_BASE version"
	help
	  Fix version type as Y560_L02_BASE.
	  
config HUAWEI_USB
	depends on ARCH_MSM8909
	bool "HUAWEI_USB version"
	help
	  Fix version type as HUAWEI_USB.
	  
#==========y560 CONFIG end===========================
```

## drivers/input/touchscreen/msg22xx/Kconfig
```kconfig
#
# Mstar Msg22xx Touchscreen driver
#

#add by litao for msg22xx touch 2014-11-05 begin		  
config TOUCHSCREEN_MSG22XX
	bool "Mstar touchpanel MSG22XX series"
	depends on I2C
	help
	  Say Y here if you have a Mstar MSG22XX touchscreen.
	  MSG22XX controllers are multi touch controllers which can
	  report 5 touches at a time.

          If unsure, say N.
#add by litao for msg22xx touch 2014-11-05 end
```
