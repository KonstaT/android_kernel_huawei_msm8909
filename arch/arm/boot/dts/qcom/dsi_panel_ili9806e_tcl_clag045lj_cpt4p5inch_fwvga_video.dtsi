/* Copyright (c) 2013, The Linux Foundation. All rights reserved.
 *
 * This program is free software; you can redistribute it and/or modify
 * it under the terms of the GNU General Public License version 2 and
 * only version 2 as published by the Free Software Foundation.
 *
 * This program is distributed in the hope that it will be useful,
 * but WITHOUT ANY WARRANTY; without even the implied warranty of
 * MERCHANTABILITY or FITNESS FOR A PARTICULAR PURPOSE.  See the
 * GNU General Public License for more details.
 */

/*---------------------------------------------------------------------------
 * This file is autogenerated file using gcdb parser. Please do not edit it.
 * Update input XML file to add a new entry or update variable in this file
 * VERSION = "1.0"
 *---------------------------------------------------------------------------*/
 /* Date            Author       IC              Module        	Why
   2015-02-14      zhouwentao   ili9806e        90245254976a   update gama para and add code version 
	2015-03-06		zhouwentao   ili9806e		clag045lj	update timing
	2015-03-06		lihuiqin    ili9806e		clag045lj	add ulps mode for suspend
      2015-04-16     xingbin    ili9806e       clag045lj    add lcd physical size
*/
&mdss_mdp {
	ili9806e_tcl_clag045lj_cpt4p5inch_fwvga_vid: qcom,ili9806e_tcl_clag045lj_cpt4p5inch {
		qcom,mdss-dsi-panel-name = "ili9806e_tcl_clag045lj_cpt4p5inch";
		qcom,mdss-dsi-panel-code-version="@20150416";
		qcom,mdss-dsi-panel-controller = <&mdss_dsi0>;
		qcom,mdss-dsi-panel-type = "dsi_video_mode";
		qcom,mdss-dsi-panel-destination = "display_1";
		qcom,mdss-dsi-panel-framerate = <60>;
		qcom,mdss-dsi-virtual-channel-id = <0>;
		qcom,mdss-dsi-stream = <0>;
		qcom,mdss-dsi-panel-width = <480>;
		qcom,mdss-dsi-panel-height = <854>;
		qcom,mdss-dsi-h-front-porch = <60>;
		qcom,mdss-dsi-h-back-porch = <60>;
		qcom,mdss-dsi-h-pulse-width = <10>;
		qcom,mdss-dsi-h-sync-skew = <0>;
		qcom,mdss-dsi-v-front-porch = <12>;
		qcom,mdss-dsi-v-back-porch = <20>;		
		qcom,mdss-dsi-v-pulse-width = <4>;
		qcom,mdss-dsi-h-left-border = <0>;
		qcom,mdss-dsi-h-right-border = <0>;
		qcom,mdss-dsi-v-top-border = <0>;
		qcom,mdss-dsi-v-bottom-border = <0>;
		qcom,mdss-dsi-bpp = <24>;
		qcom,mdss-dsi-color-order = <0>;
		qcom,mdss-dsi-underflow-color = <0xff>;
		qcom,mdss-dsi-border-color = <0>;
		qcom,mdss-dsi-pixel-packing = <0>;
		qcom,mdss-dsi-on-command = [
		39 01 00 00 00 00 06 FF FF 98 06 04 01
		39 01 00 00 00 00 02 08 10
		39 01 00 00 00 00 02 21 01
		39 01 00 00 00 00 02 30 01
		39 01 00 00 00 00 02 31 00
		39 01 00 00 00 00 02 40 18
		39 01 00 00 00 00 02 41 55
		39 01 00 00 00 00 02 42 03
		39 01 00 00 00 00 02 43 09
		39 01 00 00 00 00 02 44 86
		39 01 00 00 00 00 02 46 44
		39 01 00 00 00 00 02 47 44
		39 01 00 00 00 00 02 50 90
		39 01 00 00 00 00 02 51 90
		39 01 00 00 00 00 02 52 00
		39 01 00 00 00 00 02 53 24
		39 01 00 00 00 00 02 57 50
		39 01 00 00 00 00 02 60 07
		39 01 00 00 00 00 02 61 00
		39 01 00 00 00 00 02 62 07
		39 01 00 00 00 00 02 63 00
		39 01 00 00 00 00 02 A0 00
		39 01 00 00 00 00 02 A1 07
		39 01 00 00 00 00 02 A2 0E
		39 01 00 00 00 00 02 A3 10
		39 01 00 00 00 00 02 A4 07
		39 01 00 00 00 00 02 A5 1D
		39 01 00 00 00 00 02 A6 08
		39 01 00 00 00 00 02 A7 08
		39 01 00 00 00 00 02 A8 03
		39 01 00 00 00 00 02 A9 08
		39 01 00 00 00 00 02 AA 04
		39 01 00 00 00 00 02 AB 04
		39 01 00 00 00 00 02 AC 0b
		39 01 00 00 00 00 02 AD 34
		39 01 00 00 00 00 02 AE 2D
		39 01 00 00 00 00 02 AF 00
		39 01 00 00 00 00 02 C0 00
		39 01 00 00 00 00 02 C1 03
		39 01 00 00 00 00 02 C2 0F
		39 01 00 00 00 00 02 C3 0F
		39 01 00 00 00 00 02 C4 0A
		39 01 00 00 00 00 02 C5 17
		39 01 00 00 00 00 02 C6 09
		39 01 00 00 00 00 02 C7 09
		39 01 00 00 00 00 02 C8 05
		39 01 00 00 00 00 02 C9 06
		39 01 00 00 00 00 02 CA 04
		39 01 00 00 00 00 02 CB 04
		39 01 00 00 00 00 02 CC 0b
		39 01 00 00 00 00 02 CD 2b
		39 01 00 00 00 00 02 CE 23
		39 01 00 00 00 00 02 CF 00
		39 01 00 00 00 00 06 FF FF 98 06 04 06
		39 01 00 00 00 00 02 00 21
		39 01 00 00 00 00 02 01 06
		39 01 00 00 00 00 02 02 00
		39 01 00 00 00 00 02 03 00
		39 01 00 00 00 00 02 04 16
		39 01 00 00 00 00 02 05 16
		39 01 00 00 00 00 02 06 80
		39 01 00 00 00 00 02 07 02
		39 01 00 00 00 00 02 08 07
		39 01 00 00 00 00 02 09 00
		39 01 00 00 00 00 02 0a 00
		39 01 00 00 00 00 02 0b 00
		39 01 00 00 00 00 02 0c 16
		39 01 00 00 00 00 02 0d 16
		39 01 00 00 00 00 02 0e 00
		39 01 00 00 00 00 02 0F 00
		39 01 00 00 00 00 02 10 77
		39 01 00 00 00 00 02 11 f0
		39 01 00 00 00 00 02 12 00
		39 01 00 00 00 00 02 13 00
		39 01 00 00 00 00 02 14 00
		39 01 00 00 00 00 02 15 c0
		39 01 00 00 00 00 02 16 08
		39 01 00 00 00 00 02 17 00
		39 01 00 00 00 00 02 18 00
		39 01 00 00 00 00 02 19 00
		39 01 00 00 00 00 02 1a 00
		39 01 00 00 00 00 02 1b 00
		39 01 00 00 00 00 02 1c 00
		39 01 00 00 00 00 02 1d 00
		39 01 00 00 00 00 02 20 01
		39 01 00 00 00 00 02 21 23
		39 01 00 00 00 00 02 22 45
		39 01 00 00 00 00 02 23 67
		39 01 00 00 00 00 02 24 01
		39 01 00 00 00 00 02 25 23
		39 01 00 00 00 00 02 26 45
		39 01 00 00 00 00 02 27 67
		39 01 00 00 00 00 02 30 11
		39 01 00 00 00 00 02 31 22
		39 01 00 00 00 00 02 32 11
		39 01 00 00 00 00 02 33 00
		39 01 00 00 00 00 02 34 66
		39 01 00 00 00 00 02 35 88
		39 01 00 00 00 00 02 36 22
		39 01 00 00 00 00 02 37 22
		39 01 00 00 00 00 02 38 aa
		39 01 00 00 00 00 02 39 cc
		39 01 00 00 00 00 02 3a bb
		39 01 00 00 00 00 02 3b dd
		39 01 00 00 00 00 02 3c 22
		39 01 00 00 00 00 02 3d 22
		39 01 00 00 00 00 02 3e 22
		39 01 00 00 00 00 02 3F 22
		39 01 00 00 00 00 02 40 22
		39 01 00 00 00 00 02 52 10
		39 01 00 00 00 00 02 53 10
		39 01 00 00 00 00 06 FF FF 98 06 04 07
		39 01 00 00 00 00 02 06 13
		39 01 00 00 00 00 02 17 22
		39 01 00 00 00 00 02 02 77
		39 01 00 00 00 00 06 FF FF 98 06 04 00
		39 01 00 00 00 00 02 35 00
		39 01 00 00 05 00 02 55 01
		39 01 00 00 78 00 02 11 00
		39 01 00 00 14 00 02 29 00
		];
		qcom,mdss-dsi-off-command = [05 01 00 00 32 00 02 28 00
					05 01 00 00 78 00 02 10 00];
		qcom,mdss-dsi-on-command-state = "dsi_lp_mode";
		qcom,mdss-dsi-off-command-state = "dsi_hs_mode";
		qcom,suspend-ulps-enabled;
		qcom,mdss-pan-physical-width-dimension = <55>;
		qcom,mdss-pan-physical-height-dimension = <98>;
		qcom,mdss-dsi-h-sync-pulse = <1>;
		qcom,mdss-dsi-traffic-mode = <2>;
		qcom,mdss-dsi-lane-map = <0>;
		qcom,mdss-dsi-bllp-eof-power-mode;
		qcom,mdss-dsi-bllp-power-mode;
		qcom,mdss-dsi-dma-trigger = <4>;
		qcom,mdss-dsi-mdp-trigger = <0>;
		qcom,mdss-dsi-lane-0-state;
		qcom,mdss-dsi-lane-1-state;
		qcom,mdss-dsi-panel-timings = [76 18 10 00 3A 3E 14 1C 12 03 04 00];
		qcom,mdss-dsi-t-clk-post = <0x04>;
		qcom,mdss-dsi-t-clk-pre = <0x19>;
		qcom,mdss-dsi-bl-min-level = <0>;
		qcom,mdss-dsi-bl-max-level = <255>;
		qcom,mdss-pan-bl-levels = <1 255>;
		qcom,mdss-dsi-bl-pmic-control-type = "bl_ctrl_dcs";
		qcom,mdss-dsi-bl-pmic-pwm-frequency = <100>;
		qcom,mdss-dsi-bl-pmic-bank-select = <0>;
		qcom,mdss-dsi-pwm-gpio = <&pm8909_mpps 2 0>;
		qcom,mdss-dsi-reset-sequence = <1 20>, <0 20>, <1 120>;
	};
};